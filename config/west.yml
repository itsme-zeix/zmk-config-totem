## config/west.yml
```yaml
manifest:
  remotes:
    - name: zmkfirmware
      url-base: https://github.com/zmkfirmware
    - name: itsme-zeix                            # <---
      url-base: https://github.com/itsme-zeix     # <---
    - name: caksoylar                             # <---
      url-base: https://github.com/caksoylar      # <---
    
  projects:
    - name: zmk
      remote: zmkfirmware
      revision: main
      import: app/west.yml
    - name: forager-zmk-module                    # <---
      remote: itsme-zeix                          # <---
      revision: main                              # <---
    - name: zmk-rgbled-widget                     # <---
      remote: caksoylar                           # <---
      revision: main                              # <---
    
  self:
    path: config
```
